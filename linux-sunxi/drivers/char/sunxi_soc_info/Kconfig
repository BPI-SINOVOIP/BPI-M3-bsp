## linux-sunxi/drivers/char/sunxi_soc_info/Kconfig
```kconfig
#
# sunxi cpus test configuration.
#

config SUNXI_SOC_INFO
	tristate "sunxi SOC info driver"
	default y
        depends on SUNXI_TRUSTZONE

	
```

## linux-sunxi/drivers/cpuidle/Kconfig.arm
```kconfig
#
# ARM CPU Idle drivers
#

config ARM_BIG_LITTLE_CPUIDLE
	bool "Support for ARM big.LITTLE processors"
	depends on ARCH_VEXPRESS_TC2_PM
	select ARM_CPU_SUSPEND
	select CPU_IDLE_MULTIPLE_DRIVERS
	help
	  Select this option to enable CPU idle driver for big.LITTLE based
	  ARM systems. Driver manages CPUs coordination through MCPM and
	  define different C-states for little and big cores through the
	  multiple CPU idle drivers infrastructure.

config ARM_SUNXI_CPUIDLE
	bool "CPU Idle Driver for SUNXI"
	depends on ARCH_SUNXI && EVB_PLATFORM
	default y
	help
	  Select this to enable cpuidle on sunxi platform.

config ARM_SUN8IW6_CPUIDLE
	bool "CPU Idle Driver for SUN8IW6"
	depends on ARCH_SUN8IW6 && EVB_PLATFORM
	default n
	help
	  Select this to enable cpuidle on sun8iw6 platform.
```
